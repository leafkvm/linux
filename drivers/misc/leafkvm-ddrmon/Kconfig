## drivers/misc/leafkvm-ddrmon/Kconfig
```kconfig
# SPDX-License-Identifier: GPL-2.0-only
config LEAFKVM_DDRMON
	tristate "RV1126B DDR3 bandwidth telemetry for LeafKVM"
	depends on OF && COMMON_CLK
	depends on ARCH_ROCKCHIP || COMPILE_TEST
	select MFD_SYSCON
	help
	  Read-only character device /dev/leafkvm-ddrmon reporting DDR3 payload
	  bandwidth from the RV1126B DDRMON block, independent of DMC/devfreq.
	  Requires the DFI and DMC device tree nodes to stay disabled.  See
	  drivers/misc/leafkvm-ddrmon/ABI.txt.

	  To compile this driver as a module, choose M here: the module
	  will be called leafkvm-ddrmon.
```

## drivers/misc/rk-vicap/Kconfig
```kconfig
# SPDX-License-Identifier: GPL-2.0-only
config VIDEO_ROCKCHIP_VICAP_LEAFKVM
	tristate "RV1126B MIPI CSI-2 receiver for the LeafKVM HDMI bridge"
	depends on OF
	depends on ARCH_ROCKCHIP || COMPILE_TEST
	depends on ROCKCHIP_IOMMU
	select DMA_SHARED_BUFFER
	select GENERIC_PHY
	help
	  Character device /dev/vicap receiving the HDMI-to-CSI bridge's
	  CSI-2 stream (D-PHY through the generic PHY API, DesignWare CSI-2
	  host, one RV1126B VICAP MIPI path) into imported dma-bufs, with
	  whole-frame or progressive (rows ready while the frame is still
	  being captured) completion records.  Binds a device tree node
	  "leafkvm,rv1126b-vicap" in place of the vendor rkcif, mipi-csi2 and
	  csi2-dphy drivers.  No V4L2: the stream is agreed with the bridge in
	  userspace.  See include/uapi/linux/rk-vicap.h.

	  To compile this driver as a module, choose M here: the module
	  will be called rk-vicap.
```

## drivers/rknpu/Kconfig
```kconfig
# SPDX-License-Identifier: GPL-2.0
menu "RKNPU"
	depends on ARCH_ROCKCHIP

config ROCKCHIP_RKNPU
	tristate "ROCKCHIP_RKNPU"
	depends on DRM || DMA_SHARED_BUFFER
	help
	  rknpu module.

if ROCKCHIP_RKNPU

config ROCKCHIP_RKNPU_DEBUG_FS
	bool "RKNPU debugfs"
	depends on DEBUG_FS
	default y
	help
	  Enable debugfs to debug RKNPU usage.

config ROCKCHIP_RKNPU_PROC_FS
	bool "RKNPU procfs"
	depends on PROC_FS
	help
	  Enable procfs to debug RKNPU usage.

config ROCKCHIP_RKNPU_FENCE
	bool "RKNPU fence"
	depends on SYNC_FILE
	help
	  Enable fence support for RKNPU.

config ROCKCHIP_RKNPU_SRAM
	bool "RKNPU SRAM"
	depends on NO_GKI
	help
	  Enable RKNPU SRAM support

choice
	prompt "RKNPU memory manager"
	default ROCKCHIP_RKNPU_DRM_GEM
	help
	  Select RKNPU memory manager

config ROCKCHIP_RKNPU_DRM_GEM
	bool "RKNPU DRM GEM"
	depends on DRM
	help
	  Enable RKNPU memory manager by DRM GEM.

config ROCKCHIP_RKNPU_DMA_HEAP
	bool "RKNPU DMA heap"
	depends on DMA_SHARED_BUFFER
	help
	  Import userspace-allocated DMA-BUFs, including system-heap buffers
	  on devices with an IOMMU. CMA is not required.

endchoice

config ROCKCHIP_RKNPU_LEGACY_ALLOC
	bool "RKNPU legacy kernel CMA allocation"
	depends on ROCKCHIP_RKNPU_DMA_HEAP && DMABUF_HEAPS_ROCKCHIP_CMA_HEAP
	default y
	help
	  Keep the vendor MEM_CREATE allocation path. When disabled, userspace
	  must allocate a DMA-BUF and pass its fd to MEM_CREATE for import.

endif

endmenu
```
